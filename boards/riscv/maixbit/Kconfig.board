## boards/riscv/maixbit/Kconfig.board
```kconfig
# SPDX-License-Identifier: Apache-2.0

config BOARD_MAIXBIT
	bool "MAIX BIT target"
	depends on SOC_K210
```

## boards/riscv/maixbit/Kconfig.defconfig
```kconfig
# SPDX-License-Identifier: Apache-2.0

if BOARD_MAIXBIT

config BUILD_OUTPUT_BIN
	default y

config BOARD
	default "maixbit"

endif
```

## boards/riscv/maixbit/maixbit_defconfig
```kconfig
# SPDX-License-Identifier: Apache-2.0

CONFIG_SOC_SERIES_K210=y
CONFIG_SOC_K210=y
CONFIG_BOARD_MAIXBIT=y
CONFIG_RISCV_MACHINE_TIMER=y
CONFIG_CONSOLE=y
CONFIG_SERIAL=y
CONFIG_UART_SIFIVE=y
CONFIG_UART_SIFIVE_PORT_0=y
CONFIG_UART_CONSOLE=y
CONFIG_XIP=n
```

## soc/riscv/riscv-privilege/k210/Kconfig.defconfig.series
```kconfig
# Copyright (c) 2020 Cobham Gaisler AB
# SPDX-License-Identifier: Apache-2.0

if SOC_SERIES_K210

config SOC_SERIES
	default "k210"

config SYS_CLOCK_HW_CYCLES_PER_SEC
	default 7800000

config RISCV_SOC_INTERRUPT_INIT
	default y

config RISCV_HAS_CPU_IDLE
	default y

config RISCV_GP
	default y

config NUM_IRQS
	default 64

endif
```

## soc/riscv/riscv-privilege/k210/Kconfig.series
```kconfig
# Copyright (c) 2020 Cobham Gaisler AB
# SPDX-License-Identifier: Apache-2.0

config SOC_SERIES_K210
	bool "K210 series"
	select RISCV
	select SOC_FAMILY_RISCV_PRIVILEGE
```

## soc/riscv/riscv-privilege/k210/Kconfig.soc
```kconfig
# Copyright (c) 2020 Cobham Gaisler AB
# SPDX-License-Identifier: Apache-2.0

choice
	prompt "K210 implementation"
	depends on SOC_SERIES_K210

config SOC_K210
	bool "K210"
	select INCLUDE_RESET_VECTOR
	select 64BIT

endchoice
```
